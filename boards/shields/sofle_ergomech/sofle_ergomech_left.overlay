/*
 * Copyright (c) 2020 Ryan Cross
 *
 * SPDX-License-Identifier: MIT
 */

#include "sofle_ergomech.dtsi"

#include <behaviors/input_processor_gestures.dtsi>
#include <behaviors/input_processor_absolute_to_relative.dtsi>
#include <input/processors.dtsi>
#include <dt-bindings/zmk/input_transform.h>

&zip_gestures {
    status = "okay";
    tap-detection;
    inertial-cursor;
    circular-scroll;
    circular-scroll-rim-percent = <13>; // Set rim activation area to 13%
    prevent_movement_during_tap; // Prevent cursor drift during taps
    inertial-cursor-decay-percent = <95>; // Set inertia decay (lower = more friction)
    // Optional gesture parameters can be added here
};


&kscan0 {
    col-gpios
        = <&pro_micro 19 GPIO_ACTIVE_HIGH>
        , <&pro_micro 18 GPIO_ACTIVE_HIGH>
        , <&pro_micro 15 GPIO_ACTIVE_HIGH>
        , <&pro_micro 14 GPIO_ACTIVE_HIGH>
        , <&pro_micro 16 GPIO_ACTIVE_HIGH>
        , <&pro_micro 10 GPIO_ACTIVE_HIGH>
        ;
};

&left_encoder {
    status = "okay";
};

&glidepoint_listener {
    status = "okay";
    input-processors = <
        &zip_gestures
        &zip_absolute_to_relative
    >;
};
